/*
 * Tissot misc.dtsi - LED, IR blaster, and misc peripherals.
 * Ported from original kernel/xiaomi/msm8953 tissot DTS.
 */

/* AW2013 tri-color notification LED */
&led_aw2013 {
	AW2013_LED(green, 1)
	AW2013_LED(blue, 2)
};

/* SPI6 IR blaster (peel_ir) */
&spi_6 {
	status = "okay";
};

&spi_peel_ir {
	status = "okay";
};
